## CMakeLists.txt
```
cmake_minimum_required(VERSION 3.20.0)

find_package(Zephyr REQUIRED HINTS $ENV{ZEPHYR_BASE})

project(ble_app)

target_sources(app PRIVATE src/main.c)
```

## prj.conf
```kconfig
# ==========================================
# 1. SERIAL & CONSOLE SUBSYSTEMS
# ==========================================
CONFIG_SERIAL=y
CONFIG_CONSOLE=y
CONFIG_UART_CONSOLE=y
CONFIG_UART_LINE_CTRL=y

# ==========================================
# 2. MODERN USB STACK (For ttyACM0)
# ==========================================
CONFIG_USB_DEVICE_STACK_NEXT=y
CONFIG_CDC_ACM_SERIAL_INITIALIZE_AT_BOOT=y

# ==========================================
# 3. HARDWARE PERIPHERALS
# ==========================================
# Required to control the physical LED pin
CONFIG_GPIO=y

# ==========================================
# 4. MULTI-CORE SCHEDULING (SMP)
# ==========================================
# Required to wake up CPU 1 and allow thread pinning
CONFIG_SMP=y
CONFIG_SCHED_CPU_MASK=y
```

## src/main.c
```c
#include <zephyr/kernel.h>
#include <zephyr/drivers/gpio.h>
#include <zephyr/drivers/uart.h>
#include <zephyr/sys/printk.h>

/* --- 1. HARDWARE MAPPING --- */
#define LED0_NODE DT_ALIAS(led0)
static const struct gpio_dt_spec led = GPIO_DT_SPEC_GET(LED0_NODE, gpios);

#define STACKSIZE 1024
#define PRIORITY 7

/* --- 2. THE SEMAPHORES (The Tokens) --- */
K_SEM_DEFINE(thread_a_sem, 1, 1); /* Thread A gets the green light first */
K_SEM_DEFINE(thread_b_sem, 0, 1); /* Thread B is locked at boot */


/* --- 3. THE SHARED ENGINE --- 
 * Both threads run this exact same function, but pass different parameters.
 */
void led_ping_pong_engine(const char *name, struct k_sem *my_sem, struct k_sem *other_sem, int led_target_state)
{
	while (1) {
		/* 1. Wait for my turn */
		k_sem_take(my_sem, K_FOREVER);

		/* 2. Change the physical LED state */
		gpio_pin_set_dt(&led, led_target_state);

		/* 3. Print to the USB Console */
		printk("%s set the LED %s!\n", name, led_target_state ? "ON" : "OFF");

		/* 4. Keep the LED in this state for 500ms */
		k_msleep(500);

		/* 5. Wake up the OTHER thread */
		k_sem_give(other_sem);
	}
}


/* --- 4. THREAD B: THE STATIC ROUTE --- 
 * Created at compile time. It runs automatically in the background.
 */
void thread_b_entry(void *dummy1, void *dummy2, void *dummy3)
{
	/* Thread B's job is to turn the LED OFF (0) */
	led_ping_pong_engine("Thread B [STATIC]", &thread_b_sem, &thread_a_sem, 0);
}
/* This macro builds and launches Thread B automatically */
K_THREAD_DEFINE(thread_b_id, STACKSIZE, thread_b_entry, NULL, NULL, NULL, PRIORITY, 0, 0);


/* --- 5. THREAD A: THE DYNAMIC ROUTE --- 
 * We manually allocate the RAM here, but we don't start it yet.
 */
void thread_a_entry(void *dummy1, void *dummy2, void *dummy3)
{
	/* Thread A's job is to turn the LED ON (1) */
	led_ping_pong_engine("Thread A [DYNAMIC]", &thread_a_sem, &thread_b_sem, 1);
}
/* Manually define the stack array and the Thread Control Block (TCB) */
K_THREAD_STACK_DEFINE(thread_a_stack, STACKSIZE);
static struct k_thread thread_a_data;


/* --- 6. THE MAIN GATEKEEPER --- */
int main(void)
{
	/* A. Wait for the USB Serial to connect */
	const struct device *const dev = DEVICE_DT_GET(DT_CHOSEN(zephyr_console));
	uint32_t dtr = 0;
	if (device_is_ready(dev)) {
		while (!dtr) {
			uart_line_ctrl_get(dev, UART_LINE_CTRL_DTR, &dtr);
			k_sleep(K_MSEC(100));
		}
	}

	/* B. Initialize the Physical LED Hardware */
	if (!gpio_is_ready_dt(&led)) {
		printk("Error: LED device is not ready\n");
		return 0;
	}
	gpio_pin_configure_dt(&led, GPIO_OUTPUT_ACTIVE);

	printk("\n--- Starting Hybrid Thread Demo ---\n");

	/* C. Dynamically Create Thread A (Frozen) */
	k_thread_create(&thread_a_data, thread_a_stack,
			K_THREAD_STACK_SIZEOF(thread_a_stack),
			thread_a_entry, NULL, NULL, NULL,
			PRIORITY, 0, K_FOREVER);

	/* D. SMP Core Pinning (Optional, if CONFIG_SMP=y is in prj.conf) */
/* D. SMP Core Pinning (Protected by Preprocessor!) */
#if IS_ENABLED(CONFIG_SMP) && IS_ENABLED(CONFIG_SCHED_CPU_MASK)
	if (arch_num_cpus() > 1) {
		k_thread_cpu_pin(&thread_a_data, 0);
		
		k_thread_suspend(thread_b_id);
		k_thread_cpu_pin(thread_b_id, 1);
		k_thread_resume(thread_b_id);
	}
#endif
	/* E. Pull the trigger to start Thread A! */
	k_thread_start(&thread_a_data);

	/* main() is done. The RTOS scheduler takes over completely. */
	return 0;
}
```

## src/main2.c
```c
#include <zephyr/kernel.h>
#include <zephyr/drivers/gpio.h>
#include <zephyr/sys/printk.h>

/* Get the LED node from the board's Device Tree */
#define LED0_NODE DT_ALIAS(led0)

/* Verify that the board defines an LED alias */
#if !DT_NODE_HAS_STATUS(LED0_NODE, okay)
#error "Unsupported board: led0 alias is not defined"
#endif

/* Create a GPIO specification from the Device Tree */
static const struct gpio_dt_spec led = GPIO_DT_SPEC_GET(LED0_NODE, gpios);

int main(void)
{
    int ret;

    if (!gpio_is_ready_dt(&led)) {
        return 0;
    }

    ret = gpio_pin_configure_dt(&led, GPIO_OUTPUT_ACTIVE);
    if (ret < 0) {
        return 0;
    }

    while (1) {
        gpio_pin_toggle_dt(&led);
        k_msleep(500);
    }

    return 0;
}
```

## src/main3.c
```c
/* main.c - Synchronization demo */

/*
 * Copyright (c) 2012-2014 Wind River Systems, Inc.
 *
 * SPDX-License-Identifier: Apache-2.0
 */

#include <zephyr/kernel.h>
#include <zephyr/sys/printk.h>
#include <zephyr/drivers/uart.h>

/*
 * The synchronization demo has two threads that utilize semaphores and sleeping
 * to take turns printing a greeting message at a controlled rate. The demo
 * shows both the static and dynamic approaches for spawning a thread; a real
 * world application would likely use the static approach for both threads.
 */

#define PIN_THREADS (IS_ENABLED(CONFIG_SMP) && IS_ENABLED(CONFIG_SCHED_CPU_MASK))

/* size of stack area used by each thread */
#define STACKSIZE 1024

/* scheduling priority used by each thread */
#define PRIORITY 7

/* delay between greetings (in ms) */
#define SLEEPTIME 500


/*
 * @param my_name      thread identification string
 * @param my_sem       thread's own semaphore
 * @param other_sem    other thread's semaphore
 */
void hello_loop(const char *my_name,
		   struct k_sem *my_sem, struct k_sem *other_sem)
{
	const char *tname;
	uint8_t cpu;
	struct k_thread *current_thread;

	while (1) {
		/* take my semaphore */
		k_sem_take(my_sem, K_FOREVER);

		current_thread = k_current_get();
		tname = k_thread_name_get(current_thread);
#if CONFIG_SMP
		cpu = arch_curr_cpu()->id;
#else
		cpu = 0;
#endif
		/* say "hello" */
		if (tname == NULL) {
			printk("%s: Hello World from cpu %d on %s!\n",
				my_name, cpu, CONFIG_BOARD);
		} else {
			printk("%s: Hello World from cpu %d on %s!\n",
				tname, cpu, CONFIG_BOARD);
		}

		/* wait a while, then let other thread have a turn */
		k_busy_wait(100000);
		k_msleep(SLEEPTIME);
		k_sem_give(other_sem);
	}
}

/* define semaphores */
K_SEM_DEFINE(thread_a_sem, 1, 1);	/* starts off "available" */
K_SEM_DEFINE(thread_b_sem, 0, 1);	/* starts off "not available" */

/* thread_a is a dynamic thread that is spawned in main */
void thread_a_entry_point(void *dummy1, void *dummy2, void *dummy3)
{
	ARG_UNUSED(dummy1);
	ARG_UNUSED(dummy2);
	ARG_UNUSED(dummy3);

	/* invoke routine to ping-pong hello messages with thread_b */
	hello_loop(__func__, &thread_a_sem, &thread_b_sem);
}
K_THREAD_STACK_DEFINE(thread_a_stack_area, STACKSIZE);
static struct k_thread thread_a_data;

/* thread_b is a static thread spawned immediately */
void thread_b_entry_point(void *dummy1, void *dummy2, void *dummy3)
{
	ARG_UNUSED(dummy1);
	ARG_UNUSED(dummy2);
	ARG_UNUSED(dummy3);

	/* invoke routine to ping-pong hello messages with thread_a */
	hello_loop(__func__, &thread_b_sem, &thread_a_sem);
}
K_THREAD_DEFINE(thread_b, STACKSIZE,
				thread_b_entry_point, NULL, NULL, NULL,
				PRIORITY, 0, 0);
extern const k_tid_t thread_b;

int main(void)
{


	const struct device *const dev = DEVICE_DT_GET(DT_CHOSEN(zephyr_console));
	uint32_t dtr =0;

	if(device_is_ready(dev)){
		while(!dtr)
		{
			uart_line_ctrl_get(dev, UART_LINE_CTRL_DTR, &dtr);
			k_sleep(K_MSEC(100));
		}
	}
	k_thread_create(&thread_a_data, thread_a_stack_area,
			K_THREAD_STACK_SIZEOF(thread_a_stack_area),
			thread_a_entry_point, NULL, NULL, NULL,
			PRIORITY, 0, K_FOREVER);
	k_thread_name_set(&thread_a_data, "thread_a");

#if PIN_THREADS
	if (arch_num_cpus() > 1) {
		k_thread_cpu_pin(&thread_a_data, 0);

		/*
		 * Thread b is a static thread that is spawned immediately. This means that the
		 * following `k_thread_cpu_pin` call can fail with `-EINVAL` if the thread is
		 * actively running. Let's suspend the thread and resume it after the affinity mask
		 * is set.
		 */
		k_thread_suspend(thread_b);
		k_thread_cpu_pin(thread_b, 1);
		k_thread_resume(thread_b);
	}
#endif

	k_thread_start(&thread_a_data);
	return 0;
}
```
